/*****************************************************************************
* Product: DPP example, Win32-GUI
* Last updated for version 5.9.0
* Last updated on  2017-04-15
*
*                    Q u a n t u m     L e a P s
*                    ---------------------------
*                    innovating embedded systems
*
* Copyright (C) Quantum Leaps, LLC. All rights reserved.
*
* This program is open source software: you can redistribute it and/or
* modify it under the terms of the GNU General Public License as published
* by the Free Software Foundation, either version 3 of the License, or
* (at your option) any later version.
*
* Alternatively, this program may be distributed and modified under the
* terms of Quantum Leaps commercial licenses, which expressly supersede
* the GNU General Public License and are specifically designed for
* licensees interested in retaining the proprietary status of their code.
*
* This program is distributed in the hope that it will be useful,
* but WITHOUT ANY WARRANTY; without even the implied warranty of
* MERCHANTABILITY or FITNESS FOR A PARTICULAR PURPOSE. See the
* GNU General Public License for more details.
*
* You should have received a copy of the GNU General Public License
* along with this program. If not, see <http://www.gnu.org/licenses/>.
*
* Contact information:
* https://state-machine.com
* mailto:info@state-machine.com
*****************************************************************************/
#include <string.h>
#include <stdio.h>    /* for _snprintf_s() */
#include <stdlib.h>

#include "qpc.h"
#include "qwin_gui.h" /* QWIN GUI */
#include "safe_std.h"

#include "trafficlight.h"
#include "bsp.h"
#include "bsp-gui.h"
#include "resource.h" /* GUI resource IDs generated by the resource editior */

Q_DEFINE_THIS_FILE

/* local variables ---------------------------------------------------------*/
static HINSTANCE l_hInst;   /* this application instance */
static HWND      l_hWnd;    /* main window handle */
static LPSTR     *_argv;
static int        _argc;

static SegmentDisplay   l_trafficlights[3];   /* SegmentDisplay to show Philo status */
static SegmentDisplay   l_pedLed;
static SegmentDisplay   l_timeDisplay;
static OwnerDrawnButton l_pedBtn;
// static uint8_t keyPressed = 0;

static const DWORD trafficlightsSeg[MaxIdentity][MAX_LIGHT] = {
    { IDC_RED_A, IDC_YELLOW_A, IDC_GREEN_A },
    { IDC_RED_B, IDC_YELLOW_B, IDC_GREEN_B },
    { IDC_RED_P, 0xFFFFu,      IDC_GREEN_P }
};
static const DWORD idLedPed[] = { IDC_LED_PED };
static const DWORD trafficlightsBmp[MAX_LIGHT + 1] = {
    IDB_TL_OFF, IDB_TL_RED, IDB_TL_YELLOW, IDB_TL_GREEN
};
static const DWORD ledBmp[2] = {
    IDB_TL_LEDWHITE, IDB_TL_LEDRED
};

static const DWORD timeDisplaySeg[] = {
    IDC_DIGIT1, IDC_DIGIT2, IDC_DIGIT3
};
static const DWORD timeDisplayBmp[] = {
    IDB_SEG0, IDB_SEG1, IDB_SEG2, IDB_SEG3, IDB_SEG4,
    IDB_SEG5, IDB_SEG6, IDB_SEG7, IDB_SEG8, IDB_SEG9
};

/* Local functions ---------------------------------------------------------*/
static LRESULT CALLBACK WndProc(HWND hWnd, UINT iMsg,
                                WPARAM wParam, LPARAM lParam);

static void initSegmentDisplay(SegmentDisplay *sd, DWORD const seg[], DWORD const segCnt, DWORD const bmp[], DWORD const bmpCnt);

static void WriteTime(DWORD t);

/*..........................................................................*/
/* thread function for running the application main_gui() */
static DWORD WINAPI appThread(LPVOID par)
{
    (void)par;  // unused
    // BSP/QPC pre intialization
    BSP_HW_init();
    QF_init();    /* initialize the framework and the underlying RT kernel */
    BSP_init(_argc, _argv); /* initialize the Board Support Package */
    return (DWORD)tlMain(); /* run the QF application */
}

/*--------------------------------------------------------------------------*/
int startGui(int argc, char *argv[])
{
    HWND hWnd;
    MSG  msg;

    l_hInst = GetModuleHandle(NULL);   /* save the application instance */
    _argv   = argv;
    _argc   = argc;

    //AllocConsole();

    /* create the main custom dialog window */
    hWnd = CreateCustDialog(l_hInst, IDD_APPLICATION, NULL,
                            &WndProc, "QP_APP");
    ShowWindow(hWnd, SW_SHOWNORMAL);  /* show the main window */

    /* enter the message loop... */
    while (GetMessage(&msg, NULL, 0, 0)) {
        TranslateMessage(&msg);
        DispatchMessage(&msg);
    }

    //FreeConsole();
    BSP_terminate(0);

    return msg.wParam;
}

/*..........................................................................*/
static LRESULT CALLBACK WndProc(HWND hWnd, UINT iMsg,
                                WPARAM wParam, LPARAM lParam)
{
    UINT n;

    switch (iMsg) {

        /* Perform initialization upon cration of the main dialog window
        * NOTE: Any child-windows are NOT created yet at this time, so
        * the GetDlgItem() function can't be used (it will return NULL).
        */
        case WM_CREATE: {
            l_hWnd = hWnd; /* save the window handle */

            /* initialize the owner-drawn buttons...
            * NOTE: must be done *before* the first drawing of the buttons,
            * so WM_INITDIALOG is too late.
            */
            OwnerDrawnButton_init(&l_pedBtn, IDC_PED_BTN,
                LoadBitmap(l_hInst, MAKEINTRESOURCE(IDB_BTN_UP)),
                LoadBitmap(l_hInst, MAKEINTRESOURCE(IDB_BTN_DWN)),
                LoadCursor(NULL, IDC_HAND));
            return 0;
        }

        /* Perform initialization after all child windows have been created */
        case WM_INITDIALOG: {
            for (n = TrafficLightA; n < MaxIdentity; n++)
            {
                initSegmentDisplay(&l_trafficlights[n],
                                   trafficlightsSeg[n], sizeof(trafficlightsSeg[n])/sizeof(trafficlightsSeg[n][0]),
                                   trafficlightsBmp, sizeof(trafficlightsBmp)/sizeof(trafficlightsBmp[0]));
            }
            initSegmentDisplay(&l_pedLed,
                               idLedPed, sizeof(idLedPed)/sizeof(idLedPed[0]),
                               ledBmp, sizeof(ledBmp)/sizeof(ledBmp[0]));
            initSegmentDisplay(&l_timeDisplay,
                               timeDisplaySeg, sizeof(timeDisplaySeg)/sizeof(timeDisplaySeg[0]),
                               timeDisplayBmp, sizeof(timeDisplayBmp)/sizeof(timeDisplayBmp[0]));

            /* --> QP: spawn the application thread to run main_gui() */
            Q_ALLEGE(CreateThread(NULL, 0, &appThread, NULL, 0, NULL)
                     != (HANDLE)0);

            Q_ALLEGE(SetTimer(hWnd, 1000u, 1000u, (TIMERPROC)NULL) != 0);
            return 0;
        }

        case WM_DESTROY: {
            PostQuitMessage(0);
            return 0;
        }

        /* commands from regular buttons and menus... */
        case WM_COMMAND: {
            SetFocus(hWnd);
            switch (wParam) {
                case IDOK:
                case IDCANCEL: {
                    BSP_terminate(0);
                    KillTimer(hWnd, 1000u);
                    MessageBox(hWnd, "Bye bye...\r\nLooking forward to seeing you again", "TrafficLight", MB_OK);
                    PostQuitMessage(0);
                    break;
                case IDC_PED_BTN:
                	BSP_publishBtnEvt(); /* publish to all subscribers */
                    break;
                case IDC_EMRG_BTN:
                	{
                		static enum {
                			SetEm = 0,
							RelEm
                		} state = SetEm;
						BSP_publishEmergencyEvt(); /* publish to all subscribers */
						switch (state)
						{
							case RelEm:
								state = SetEm;
								SetDlgItemText(hWnd, IDC_EMRG_BTN, "Emergency");
								break;
							case SetEm:
								state = RelEm;
								SetDlgItemText(hWnd, IDC_EMRG_BTN, "Release");
								break;
							default:
								break;
						}

                	}
                    break;
                default:
                    break;
                }
            }
            return 0;
        }

        case WM_TIMER: {
            static DWORD timCount = 0;

            timCount++;
            if (timCount >= 1000)
                timCount = 0;
            WriteTime(timCount);
            Q_ALLEGE(SetTimer(hWnd, 1000, 1000, (TIMERPROC)NULL) != 0);
            return 0;
        }

        /* owner-drawn buttons... */
        case WM_DRAWITEM: {
            LPDRAWITEMSTRUCT pdis = (LPDRAWITEMSTRUCT)lParam;
            if (IDC_PED_BTN == pdis->CtlID) switch (OwnerDrawnButton_draw(&l_pedBtn,pdis))
			{
				case BTN_DEPRESSED:
					break;
				case BTN_RELEASED:
					BSP_publishBtnEvt();
					break;
				default:
					break;
			}
            return 0;
        }

        /* mouse input... */
        case WM_MOUSEWHEEL: {
            return 0;
        }

        /* keyboard input... */
        case WM_KEYDOWN: {
            return 0;
        }

        /* character input... */
        case WM_CHAR: {
            return 0;
        }
    }
    return DefWindowProc(hWnd, iMsg, wParam, lParam) ;
}
/*..........................................................................*/
static void initSegmentDisplay(SegmentDisplay *sd, DWORD const seg[], DWORD const segCnt, DWORD const bmp[], DWORD const bmpCnt)
{
    DWORD n;

    SegmentDisplay_init(sd, segCnt, bmpCnt);
    for (n = 0; n < segCnt; n++)
    {
        SegmentDisplay_initSegment(sd, n, seg[n]);
    }
    for (n = 0; n < bmpCnt; n++)
    {
        SegmentDisplay_initBitmap(sd, n, LoadBitmap(l_hInst, MAKEINTRESOURCE(bmp[n])));
    }
}
/*..........................................................................*/
static void WriteTime(DWORD t)
{
    DWORD t100, t010, t001;

    t100 = t / 100;
    t010 = (t % 100) / 10;
    t001 = ((t %100) % 10);

    SegmentDisplay_setSegment(&l_timeDisplay, 0, t001);
    SegmentDisplay_setSegment(&l_timeDisplay, 1, t010);
    SegmentDisplay_setSegment(&l_timeDisplay, 2, t100);
}
/*..........................................................................*/
void guiSetLight(eTLidentity_t id, uint8_t light)
{
    uint8_t  n;

    // printf("set id %d to %d\n", id, light);
    for (n = 0; n < MAX_LIGHT; n++)
    {
        if (0xFFFFu != trafficlightsSeg[id][n])
        {
            UINT lidx = (light & (0x01u << n) ? (n + 1u) : 0U);
            SegmentDisplay_setSegment(&l_trafficlights[id], n, lidx);
        }
    }
}
/*..........................................................................*/
void guiSetPedLed(uint16_t status)
{
    SegmentDisplay_setSegment(&l_pedLed, 0U, status ? 1 : 0);
}

void guiAssert(char const * const module, int_t loc) {
    char message[80];
    QF_stop(); /* stop ticking */
    QS_ASSERTION(module, loc, (uint32_t)10000U); /* report assertion to QS */
    SNPRINTF_S(message, Q_DIM(message) - 1,
               "Assertion failed in module %s location %d", module, loc);
    MessageBox(l_hWnd, message, "!!! ASSERTION !!!",
               MB_OK | MB_ICONEXCLAMATION | MB_APPLMODAL);

    PostQuitMessage(-1);
}

void guiTerminate(int16_t result)
{
    UINT n;

    /* cleanup all QWIN resources... */
    for (n = 0; n < 3; n++)
        SegmentDisplay_xtor(&l_trafficlights[n]);     /* cleanup the l_philos resources */
    SegmentDisplay_xtor(&l_pedLed);
    SegmentDisplay_xtor(&l_timeDisplay);

    /* end the main dialog */
    EndDialog(l_hWnd, result);
}


